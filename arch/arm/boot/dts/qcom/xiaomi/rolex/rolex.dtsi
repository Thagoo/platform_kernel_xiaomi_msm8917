#include "rolex-audio.dtsi"
#include "rolex-sound.dtsi"
#include "rolex-pinctrl.dtsi"
#include "rolex-camera.dtsi"
#include "rolex-mdss.dtsi"
#include "rolex-i2c.dtsi"
#include "rolex-pm.dtsi"
#include "rolex-msm8917.dtsi"
#include "rolex-regulator.dtsi"
#include "rolex-pm8937.dtsi"
