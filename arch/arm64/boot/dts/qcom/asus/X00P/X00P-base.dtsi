/*
 * Copyright (c) 2016, 2018, The Linux Foundation. All rights reserved.
 *
 * This program is free software; you can redistribute it and/or modify
 * it under the terms of the GNU General Public License version 2 and
 * only version 2 as published by the Free Software Foundation.
 *
 * This program is distributed in the hope that it will be useful,
 * but WITHOUT ANY WARRANTY; without even the implied warranty of
 * MERCHANTABILITY or FITNESS FOR A PARTICULAR PURPOSE.  See the
 * GNU General Public License for more details.
 */

#include "X00P-msm8937-mdss-panel.dtsi"
#include "X00P-msm-pm8937.dtsi"
#include "X00P-msm-pmi8940.dtsi"
#include "X00P-msm8937.dtsi"
#include "X00P-msm8937-audio.dtsi"
#include "X00P-msm8937-audio-mtp.dtsi"
#include "X00P-msm8937-camera.dtsi"
#include "X00P-msm8937-camera-pinctrl.dtsi"
#include "X00P-msm8937-camera-sensor-mtp.dtsi"
#include "X00P-msm8937-mtp.dtsi"
#include "X00P-msm8937-pinctrl.dtsi"
#include "X00P-msm8937-pmi8940-mtp.dtsi"
