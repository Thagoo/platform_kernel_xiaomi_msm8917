/*
 * Copyright (c) 2017, The Linux Foundation. All rights reserved.
 *
 * This program is free software; you can redistribute it and/or modify
 * it under the terms of the GNU General Public License version 2 and
 * only version 2 as published by the Free Software Foundation.
 *
 * This program is distributed in the hope that it will be useful,
 * but WITHOUT ANY WARRANTY; without even the implied warranty of
 * MERCHANTABILITY or FITNESS FOR A PARTICULAR PURPOSE.  See the
 * GNU General Public License for more details.
 */

dsi_panda_ili9881_720p_video: qcom,dsi_panda_ili9881_720p_video {
	qcom,mdss-dsi-panel-name = "ykl_panda_ili9881_720p_video";
	qcom,mdss-dsi-panel-controller = <&mdss_dsi0>;
	qcom,mdss-dsi-panel-type = "dsi_video_mode";
	qcom,mdss-dsi-panel-destination = "display_1"; //
	qcom,mdss-dsi-panel-framerate = <62>;
	qcom,mdss-dsi-virtual-channel-id = <0>;  //
	qcom,mdss-dsi-stream = <0>;	//
	qcom,mdss-dsi-panel-width = <720>;
	qcom,mdss-dsi-panel-height = <1440>;
	qcom,mdss-dsi-h-front-porch = <50>;
	qcom,mdss-dsi-h-back-porch = <48>;  //
	qcom,mdss-dsi-h-pulse-width = <10>; //horizontal_sync_active
	qcom,mdss-dsi-h-sync-skew = <0>;   ////
	qcom,mdss-dsi-v-back-porch = <20>;
	qcom,mdss-dsi-v-front-porch = <20>;
	qcom,mdss-dsi-v-pulse-width = <4>; ////
	qcom,mdss-dsi-h-left-border = <0>; //
	qcom,mdss-dsi-h-right-border = <0>;//
	qcom,mdss-dsi-v-top-border = <0>; //
	qcom,mdss-dsi-v-bottom-border = <0>; //
	qcom,mdss-dsi-bpp = <24>; //
	qcom,mdss-dsi-color-order = "rgb_swap_rgb";
	qcom,mdss-dsi-underflow-color = <0xff>; //
	qcom,mdss-dsi-border-color = <0>; //
	qcom,mdss-dsi-on-command = [39 01 00 00 00 00 04 FF 98 81 05
39 01 00 00 00 00 02 B2 70
39 01 00 00 00 00 02 30 F7
39 01 00 00 00 00 02 38 A8
39 01 00 00 00 00 02 1A 50
39 01 00 00 00 00 02 52 5F
39 01 00 00 00 00 02 54 28
39 01 00 00 00 00 02 55 25
39 01 00 00 00 00 02 26 02
39 01 00 00 00 00 02 3D A1
39 01 00 00 00 00 02 1B 01


39 01 00 00 00 00 04 FF 98 81 02
39 01 00 00 00 00 02 42 2F
39 01 00 00 00 00 02 01 50
39 01 00 00 00 00 02 15 10


39 01 00 00 00 00 02 57 00
39 01 00 00 00 00 02 58 1D
39 01 00 00 00 00 02 59 2B
39 01 00 00 00 00 02 5A 15
39 01 00 00 00 00 02 5B 19
39 01 00 00 00 00 02 5C 2B
39 01 00 00 00 00 02 5D 1E
39 01 00 00 00 00 02 5E 1F
39 01 00 00 00 00 02 5F 92
39 01 00 00 00 00 02 60 1D
39 01 00 00 00 00 02 61 2A
39 01 00 00 00 00 02 62 7B
39 01 00 00 00 00 02 63 19
39 01 00 00 00 00 02 64 16
39 01 00 00 00 00 02 65 4A
39 01 00 00 00 00 02 66 20
39 01 00 00 00 00 02 67 27
39 01 00 00 00 00 02 68 49
39 01 00 00 00 00 02 69 57
39 01 00 00 00 00 02 6A 25

39 01 00 00 00 00 02 6B 00
39 01 00 00 00 00 02 6C 1D
39 01 00 00 00 00 02 6D 2B
39 01 00 00 00 00 02 6E 15
39 01 00 00 00 00 02 6F 19
39 01 00 00 00 00 02 70 2B
39 01 00 00 00 00 02 71 1E
39 01 00 00 00 00 02 72 1F
39 01 00 00 00 00 02 73 92
39 01 00 00 00 00 02 74 1D
39 01 00 00 00 00 02 75 2A
39 01 00 00 00 00 02 76 7B
39 01 00 00 00 00 02 77 19
39 01 00 00 00 00 02 78 16
39 01 00 00 00 00 02 79 4A
39 01 00 00 00 00 02 7A 20
39 01 00 00 00 00 02 7B 27
39 01 00 00 00 00 02 7C 49
39 01 00 00 00 00 02 7D 57
39 01 00 00 00 00 02 7E 25


39 01 00 00 00 00 04 FF 98 81 01 
39 01 00 00 00 00 02 01 00
39 01 00 00 00 00 02 02 00
39 01 00 00 00 00 02 03 56
39 01 00 00 00 00 02 04 13
39 01 00 00 00 00 02 05 13
39 01 00 00 00 00 02 06 0a
39 01 00 00 00 00 02 07 05
39 01 00 00 00 00 02 08 05
39 01 00 00 00 00 02 09 1D
39 01 00 00 00 00 02 0a 01
39 01 00 00 00 00 02 0b 00
39 01 00 00 00 00 02 0c 3F
39 01 00 00 00 00 02 0d 29
39 01 00 00 00 00 02 0e 29
39 01 00 00 00 00 02 0f 1D
39 01 00 00 00 00 02 10 1D
39 01 00 00 00 00 02 11 00
39 01 00 00 00 00 02 12 00
39 01 00 00 00 00 02 13 08
39 01 00 00 00 00 02 14 08
39 01 00 00 00 00 02 15 00
39 01 00 00 00 00 02 16 00
39 01 00 00 00 00 02 17 00
39 01 00 00 00 00 02 18 00
39 01 00 00 00 00 02 19 00
39 01 00 00 00 00 02 1a 00
39 01 00 00 00 00 02 1b 00
39 01 00 00 00 00 02 1c 00
39 01 00 00 00 00 02 1d 00
39 01 00 00 00 00 02 1e 40
39 01 00 00 00 00 02 1f 88
39 01 00 00 00 00 02 20 08
39 01 00 00 00 00 02 21 01
39 01 00 00 00 00 02 22 00
39 01 00 00 00 00 02 23 00
39 01 00 00 00 00 02 24 00
39 01 00 00 00 00 02 25 00
39 01 00 00 00 00 02 26 00
39 01 00 00 00 00 02 27 00
39 01 00 00 00 00 02 28 33
39 01 00 00 00 00 02 29 03
39 01 00 00 00 00 02 2a 00
39 01 00 00 00 00 02 2b 00
39 01 00 00 00 00 02 2c 00
39 01 00 00 00 00 02 2d 00
39 01 00 00 00 00 02 2e 00
39 01 00 00 00 00 02 2f 00
39 01 00 00 00 00 02 30 00
39 01 00 00 00 00 02 31 00
39 01 00 00 00 00 02 32 00
39 01 00 00 00 00 02 33 00
39 01 00 00 00 00 02 34 00
39 01 00 00 00 00 02 35 00
39 01 00 00 00 00 02 36 00
39 01 00 00 00 00 02 37 00
39 01 00 00 00 00 02 38 00
39 01 00 00 00 00 02 39 0f
39 01 00 00 00 00 02 3a 2a
39 01 00 00 00 00 02 3b c0
39 01 00 00 00 00 02 3c 00
39 01 00 00 00 00 02 3d 00
39 01 00 00 00 00 02 3e 00
39 01 00 00 00 00 02 3f 00
39 01 00 00 00 00 02 40 00
39 01 00 00 00 00 02 41 e0
39 01 00 00 00 00 02 42 40
39 01 00 00 00 00 02 43 0f
39 01 00 00 00 00 02 44 31
39 01 00 00 00 00 02 45 a8
39 01 00 00 00 00 02 46 00
39 01 00 00 00 00 02 47 08
39 01 00 00 00 00 02 48 00
39 01 00 00 00 00 02 49 00
39 01 00 00 00 00 02 4a 00
39 01 00 00 00 00 02 4b 00


39 01 00 00 00 00 02 4c b2
39 01 00 00 00 00 02 4d 22
39 01 00 00 00 00 02 4e 01
39 01 00 00 00 00 02 4f f7
39 01 00 00 00 00 02 50 29
39 01 00 00 00 00 02 51 72
39 01 00 00 00 00 02 52 25
39 01 00 00 00 00 02 53 b2
39 01 00 00 00 00 02 54 22
39 01 00 00 00 00 02 55 22
39 01 00 00 00 00 02 56 22


39 01 00 00 00 00 02 57 a2
39 01 00 00 00 00 02 58 22
39 01 00 00 00 00 02 59 01
39 01 00 00 00 00 02 5a e6
39 01 00 00 00 00 02 5b 28
39 01 00 00 00 00 02 5c 62
39 01 00 00 00 00 02 5d 24
39 01 00 00 00 00 02 5e a2
39 01 00 00 00 00 02 5f 22
39 01 00 00 00 00 02 60 22
39 01 00 00 00 00 02 61 22 
39 01 00 00 00 00 02 62 ee 
39 01 00 00 00 00 02 63 02
39 01 00 00 00 00 02 64 0b
39 01 00 00 00 00 02 65 02
39 01 00 00 00 00 02 66 02
39 01 00 00 00 00 02 67 01
39 01 00 00 00 00 02 68 00
39 01 00 00 00 00 02 69 0f
39 01 00 00 00 00 02 6a 07
39 01 00 00 00 00 02 6b 55
39 01 00 00 00 00 02 6c 02
39 01 00 00 00 00 02 6d 02
39 01 00 00 00 00 02 6e 5b
39 01 00 00 00 00 02 6f 59
39 01 00 00 00 00 02 70 02
39 01 00 00 00 00 02 71 02
39 01 00 00 00 00 02 72 57
39 01 00 00 00 00 02 73 02
39 01 00 00 00 00 02 74 02
39 01 00 00 00 00 02 75 02
39 01 00 00 00 00 02 76 02
39 01 00 00 00 00 02 77 02
39 01 00 00 00 00 02 78 02
39 01 00 00 00 00 02 79 02
39 01 00 00 00 00 02 7a 0a
39 01 00 00 00 00 02 7b 02
39 01 00 00 00 00 02 7c 02
39 01 00 00 00 00 02 7d 01
39 01 00 00 00 00 02 7e 00
39 01 00 00 00 00 02 7f 0e
39 01 00 00 00 00 02 80 06
39 01 00 00 00 00 02 81 54
39 01 00 00 00 00 02 82 02
39 01 00 00 00 00 02 83 02
39 01 00 00 00 00 02 84 5a
39 01 00 00 00 00 02 85 58
39 01 00 00 00 00 02 86 02
39 01 00 00 00 00 02 87 02
39 01 00 00 00 00 02 88 56
39 01 00 00 00 00 02 89 02
39 01 00 00 00 00 02 8a 02
39 01 00 00 00 00 02 8b 02
39 01 00 00 00 00 02 8c 02
39 01 00 00 00 00 02 8d 02
39 01 00 00 00 00 02 8e 02     
39 01 00 00 00 00 02 8f 44
39 01 00 00 00 00 02 90 44

39 01 00 00 00 00 04 FF 98 81 06
39 01 00 00 00 00 02 01 03
39 01 00 00 00 00 02 2B 0A  
39 01 00 00 00 00 02 C0 CF
39 01 00 00 00 00 02 C1 2A


39 01 00 00 00 00 04 FF 98 81 00

39 01 00 00 00 00 02 35 00
39 01 00 00 00 00 02 36 00
05 01 00 00 78 00 02 11 00
05 01 00 00 14 00 02 29 00];
	qcom,mdss-dsi-off-command = [05 01 00 00 32 00 02 28 00
				05 01 00 00 78 00 02 10 00];
	qcom,mdss-dsi-on-command-state = "dsi_lp_mode"; 
	qcom,mdss-dsi-off-command-state = "dsi_lp_mode";
	qcom,mdss-dsi-h-sync-pulse = <1>;
	qcom,mdss-dsi-traffic-mode = "burst_mode";
	qcom,mdss-dsi-lane-map = "lane_map_0123";
	qcom,mdss-dsi-bllp-eof-power-mode;
	qcom,mdss-dsi-bllp-power-mode;
	qcom,mdss-dsi-lane-0-state;
	qcom,mdss-dsi-lane-1-state;
	qcom,mdss-dsi-lane-2-state;
	qcom,mdss-dsi-lane-3-state;
	qcom,mdss-dsi-panel-timings = [87 1C 12 00 42 44 18 20 17 03 04 00];
	qcom,mdss-dsi-t-clk-post = <0x04>;
	qcom,mdss-dsi-t-clk-pre = <0x1B>;
	qcom,mdss-dsi-bl-min-level = <1>;
	qcom,mdss-dsi-bl-max-level = <4095>;
	qcom,mdss-dsi-dma-trigger = "trigger_sw";
	qcom,mdss-dsi-mdp-trigger = "none";
	qcom,mdss-dsi-bl-pmic-control-type = "bl_ctrl_wled";
	qcom,mdss-dsi-reset-sequence = <1 20>, <0 20>, <1 120>;
};
