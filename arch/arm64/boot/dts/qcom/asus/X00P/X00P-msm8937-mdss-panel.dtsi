/*
 * Copyright (c) 2017, The Linux Foundation. All rights reserved.
 *
 * This program is free software; you can redistribute it and/or modify
 * it under the terms of the GNU General Public License version 2 and
 * only version 2 as published by the Free Software Foundation.
 *
 * This program is distributed in the hope that it will be useful,
 * but WITHOUT ANY WARRANTY; without even the implied warranty of
 * MERCHANTABILITY or FITNESS FOR A PARTICULAR PURPOSE.  See the
 * GNU General Public License for more details.
 */

&mdss_mdp {
	#include "display/dsi-panel-ili9881c-cpt-video.dtsi"
	#include "display/dsi_panel_st7703_jdf_lianovation_video.dtsi"	
	#include "display/dsi-panel-ili9881c-hsd-video.dtsi"
	#include "display/dsi-panel-ili9881p-panda-ykl.dtsi"
};
