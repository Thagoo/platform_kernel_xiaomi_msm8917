#include "msm8917-camera-sensor-qrd_S88508.dtsi"
#include "tiare-remove-riva.dtsi"
#include "tiare-general.dtsi"
#include "tiare-android.dtsi"
#include "tiare-audio.dtsi"
#include "tiare-battery.dtsi"
#include "tiare-camera-pinctrl.dtsi"
#include "tiare-display.dtsi"
#include "tiare-misc.dtsi"
#include "tiare-pm.dtsi"
#include "tiare-power.dtsi"
#include "tiare-regulator.dtsi"
