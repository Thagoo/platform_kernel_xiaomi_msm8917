## drivers/input/touchscreen/FT5346/Kconfig
```kconfig
config TOUCHSCREEN_FT5346
	boolean "FOCALTECH FT5346 touchpanel driver"
	depends on CONFIG_INPUT_TOUCHSCREEN
	default n
```

## drivers/platform/xiaomi/Kconfig
```kconfig
config MACH_XIAOMI_TIARE
	bool "Xiaomi Redmi Go"
	depends on ARCH_MSM8917
	help
	  Support for Xiaomi Redmi Go.
```
